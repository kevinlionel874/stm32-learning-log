# file: blink.ioc
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Mcu.Family=STM32F1
Mcu.Name=STM32F103C(8-B)Tx
Mcu.Package=LQFP48
NVIC.PriorityGroup=NVIC_PRIORITYGROUP_4
NVIC.TIM2_IRQn=true\:0\:0\:false\:false\:true\:true\:true\:true
PA13.Mode=Serial_Wire
PA13.Signal=SYS_JTMS-SWDIO
PA14.Mode=Serial_Wire
PA14.Signal=SYS_JTCK-SWCLK
PC13-TAMPER-RTC.GPIO_Label=LED
PC13-TAMPER-RTC.GPIO_ModeDefaultOutputPP=GPIO_MODE_OUTPUT_PP
PC13-TAMPER-RTC.GPIO_PuPd=GPIO_NOPULL
PC13-TAMPER-RTC.PinState=GPIO_PIN_SET
PC13-TAMPER-RTC.Signal=GPIO_Output
PD0-OSC_IN.Mode=HSE-External-Oscillator
PD0-OSC_IN.Signal=RCC_OSC_IN
PD1-OSC_OUT.Mode=HSE-External-Oscillator
PD1-OSC_OUT.Signal=RCC_OSC_OUT
ProjectManager.HeapSize=0x200
ProjectManager.StackSize=0x400
ProjectManager.TargetToolchain=STM32CubeIDE
RCC.AHBFreq_Value=72000000
RCC.APB1CLKDivider=RCC_HCLK_DIV2
RCC.APB1Freq_Value=36000000
RCC.APB1TimFreq_Value=72000000
RCC.APB2Freq_Value=72000000
RCC.APB2TimFreq_Value=72000000
RCC.HCLKFreq_Value=72000000
RCC.PLLMUL=RCC_PLL_MUL9
RCC.PLLSourceVirtual=RCC_PLLSOURCE_HSE
RCC.SYSCLKFreq_VALUE=72000000
RCC.SYSCLKSource=RCC_SYSCLKSOURCE_PLLCLK
RCC.USBFreq_Value=72000000
TIM2.Period=5000-1
TIM2.Prescaler=7200-1
VP_TIM2_VS_ClockSourceINT.Mode=Internal
board=custom

// file: Core/Src/main.c
/* USER CODE BEGIN Header */
/**
  ******************************************************************************
  * @file           : main.c
  * @brief          : Main program body
  ******************************************************************************
  * @attention
  *
  * Copyright (c) 2026 STMicroelectronics.
  * All rights reserved.
  *
  * This software is licensed under terms that can be found in the LICENSE file
  * in the root directory of this software component.
  * If no LICENSE file comes with this software, it is provided AS-IS.
  *
  ******************************************************************************
  */
/* USER CODE END Header */
#include "main.h"

TIM_HandleTypeDef htim2;

/* USER CODE BEGIN PV */
uint32_t led_last = 0;   // 上一次翻转 LED 的时间（毫秒）
uint32_t sec_last = 0;     // 上一次「秒数 +1」的时间
uint32_t seconds = 0;      // 任务 2 自己数的秒数
uint32_t loop_count = 0;   // while 循环一共跑了多少圈
volatile uint32_t tim2_count = 0;   // TIM2 中断发生了多少次（在中断里会被改，所以加 volatile）
// SOS 节奏表：亮、灭、亮、灭……依次排下去（单位：毫秒）
const uint32_t sos[] = {
  150,150, 150,150, 150,450,    // S：最后一个「灭」多等 300，表示字母结束
  450,150, 450,150, 450,450,    // O
  150,150, 150,150, 150,1050    // S：最后一个「灭」多等 900，表示一整组结束
};
#define SOS_STEPS (sizeof(sos) / sizeof(sos[0]))   // 表里一共有几步（18）

uint32_t sos_index = 0;   // 现在走到第几步（偶数步亮，奇数步灭）
uint32_t sos_last = 0;    // 这一步是什么时候开始的

/* USER CODE END PV */

void SystemClock_Config(void);
static void MX_GPIO_Init(void);
static void MX_TIM2_Init(void);

/* USER CODE BEGIN 0 */
// 点亮 LED：Blue Pill 的灯是低电平点亮，所以输出 RESET（0）
void LED_On(void)
{
  HAL_GPIO_WritePin(LED_GPIO_Port, LED_Pin, GPIO_PIN_RESET);
}

// 熄灭 LED：输出 SET（1）
void LED_Off(void)
{
  HAL_GPIO_WritePin(LED_GPIO_Port, LED_Pin, GPIO_PIN_SET);
}

// 闪一下：亮 on_ms 毫秒，再灭 off_ms 毫秒
void LED_Blink(uint32_t on_ms, uint32_t off_ms)
{
  LED_On();
  HAL_Delay(on_ms);
  LED_Off();
  HAL_Delay(off_ms);
}

/* USER CODE END 0 */

int main(void)
{

  /* MCU Configuration--------------------------------------------------------*/

  /* Reset of all peripherals, Initializes the Flash interface and the Systick. */
  HAL_Init();

  /* Configure the system clock */
  SystemClock_Config();

  /* Initialize all configured peripherals */
  MX_GPIO_Init();
  MX_TIM2_Init();
  /* USER CODE BEGIN 2 */
  LED_On();                  // 第 0 步是「亮」，所以先点亮
  sos_last = HAL_GetTick();  // 第 0 步从现在开始计时
  HAL_TIM_Base_Start_IT(&htim2);   // 启动 TIM2，并打开它的中断（IT = interrupt）

  /* USER CODE END 2 */

  /* Infinite loop */
  while (1)
  {

    /* USER CODE BEGIN 3 */
//	    // S：三短（点）
//	    for (int i = 0; i < 3; i++) LED_Blink(150, 150);
//	    HAL_Delay(300);   // 字母之间多停一会儿
//
//	    // O：三长（划）
//	    for (int i = 0; i < 3; i++) LED_Blink(450, 150);
//	    HAL_Delay(300);
//
//	    // S：三短
//	    for (int i = 0; i < 3; i++) LED_Blink(150, 150);
//	    HAL_Delay(900);   // 一整组 SOS 结束，停久一点再重来
	    uint32_t now = HAL_GetTick();   // 现在是开机后第几毫秒
//	    // 轮询版（录视频 A 用）：主循环自己看表翻转 LED
//	    if (now - led_last >= 500)
//	    {
//	      led_last = now;
//	      HAL_GPIO_TogglePin(LED_GPIO_Port, LED_Pin);
//	    }

//	    // 任务 1（新）：不卡住的 SOS，按节奏表一步一步走
//	    if (now - sos_last >= sos[sos_index])
//	    {
//	      sos_last = now;
//	      sos_index = (sos_index + 1) % SOS_STEPS;   // 走到下一步，18 步走完就回到第 0 步
//
//	      if (sos_index % 2 == 0)
//	        LED_On();    // 偶数步：亮
//	      else
//	        LED_Off();   // 奇数步：灭
//	    }
	    // 任务 2：每 1000 毫秒，秒数加 1
	    if (now - sec_last >= 1000)
	    {
	      sec_last = now;
	      seconds++;
	    }

	    loop_count++;   // 每跑一圈就加 1
	    HAL_Delay(3000);   // 实验：故意让主循shide环每圈卡 3 秒
  }
  /* USER CODE END 3 */
}

void SystemClock_Config(void)
{
  RCC_OscInitTypeDef RCC_OscInitStruct = {0};
  RCC_ClkInitTypeDef RCC_ClkInitStruct = {0};

  /** Initializes the RCC Oscillators according to the specified parameters
  * in the RCC_OscInitTypeDef structure.
  */
  RCC_OscInitStruct.OscillatorType = RCC_OSCILLATORTYPE_HSE;
  RCC_OscInitStruct.HSEState = RCC_HSE_ON;
  RCC_OscInitStruct.HSEPredivValue = RCC_HSE_PREDIV_DIV1;
  RCC_OscInitStruct.HSIState = RCC_HSI_ON;
  RCC_OscInitStruct.PLL.PLLState = RCC_PLL_ON;
  RCC_OscInitStruct.PLL.PLLSource = RCC_PLLSOURCE_HSE;
  RCC_OscInitStruct.PLL.PLLMUL = RCC_PLL_MUL9;
  if (HAL_RCC_OscConfig(&RCC_OscInitStruct) != HAL_OK)
  {
    Error_Handler();
  }

  /** Initializes the CPU, AHB and APB buses clocks
  */
  RCC_ClkInitStruct.ClockType = RCC_CLOCKTYPE_HCLK|RCC_CLOCKTYPE_SYSCLK
                              |RCC_CLOCKTYPE_PCLK1|RCC_CLOCKTYPE_PCLK2;
  RCC_ClkInitStruct.SYSCLKSource = RCC_SYSCLKSOURCE_PLLCLK;
  RCC_ClkInitStruct.AHBCLKDivider = RCC_SYSCLK_DIV1;
  RCC_ClkInitStruct.APB1CLKDivider = RCC_HCLK_DIV2;
  RCC_ClkInitStruct.APB2CLKDivider = RCC_HCLK_DIV1;

  if (HAL_RCC_ClockConfig(&RCC_ClkInitStruct, FLASH_LATENCY_2) != HAL_OK)
  {
    Error_Handler();
  }
}

static void MX_TIM2_Init(void)
{

  TIM_ClockConfigTypeDef sClockSourceConfig = {0};
  TIM_MasterConfigTypeDef sMasterConfig = {0};

  htim2.Instance = TIM2;
  htim2.Init.Prescaler = 7200-1;
  htim2.Init.CounterMode = TIM_COUNTERMODE_UP;
  htim2.Init.Period = 5000-1;
  htim2.Init.ClockDivision = TIM_CLOCKDIVISION_DIV1;
  htim2.Init.AutoReloadPreload = TIM_AUTORELOAD_PRELOAD_DISABLE;
  if (HAL_TIM_Base_Init(&htim2) != HAL_OK)
  {
    Error_Handler();
  }
  sClockSourceConfig.ClockSource = TIM_CLOCKSOURCE_INTERNAL;
  if (HAL_TIM_ConfigClockSource(&htim2, &sClockSourceConfig) != HAL_OK)
  {
    Error_Handler();
  }
  sMasterConfig.MasterOutputTrigger = TIM_TRGO_RESET;
  sMasterConfig.MasterSlaveMode = TIM_MASTERSLAVEMODE_DISABLE;
  if (HAL_TIMEx_MasterConfigSynchronization(&htim2, &sMasterConfig) != HAL_OK)
  {
    Error_Handler();
  }

}

static void MX_GPIO_Init(void)
{
  GPIO_InitTypeDef GPIO_InitStruct = {0};

  /* GPIO Ports Clock Enable */
  __HAL_RCC_GPIOC_CLK_ENABLE();
  __HAL_RCC_GPIOD_CLK_ENABLE();
  __HAL_RCC_GPIOA_CLK_ENABLE();

  /*Configure GPIO pin Output Level */
  HAL_GPIO_WritePin(LED_GPIO_Port, LED_Pin, GPIO_PIN_SET);

  /*Configure GPIO pin : LED_Pin */
  GPIO_InitStruct.Pin = LED_Pin;
  GPIO_InitStruct.Mode = GPIO_MODE_OUTPUT_PP;
  GPIO_InitStruct.Pull = GPIO_NOPULL;
  GPIO_InitStruct.Speed = GPIO_SPEED_FREQ_LOW;
  HAL_GPIO_Init(LED_GPIO_Port, &GPIO_InitStruct);

}

/* USER CODE BEGIN 4 */
// 定时器中断回调：TIM2 每数满一圈（0.5 秒），HAL 就调用一次这个函数
void HAL_TIM_PeriodElapsedCallback(TIM_HandleTypeDef *htim)
{
  if (htim->Instance == TIM2)   // 确认是 TIM2 触发的（以后可能有好几个定时器）
  {
    HAL_GPIO_TogglePin(LED_GPIO_Port, LED_Pin);
    tim2_count++;   // 每来一次中断就加 1
  }
}

/* USER CODE END 4 */

void Error_Handler(void)
{
  __disable_irq();
  while (1)
  {
  }
}
